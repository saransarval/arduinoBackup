#INCLUDE<16F877A.H>
#USE DELAY(CLOCK=11059200)
#INCLUDE<LCD.H>

#BYTE PORTB=0X06
#BYTE TRISB=0X86
#BYTE TRISC=0X87
#BYTE PORTC=0X07

#BIT PULSE1=PORTB.7/// CHANNEL 1
#BIT PULSE2=PORTB.6/// CHANNEL 2
#BIT PULSE3=PORTB.5/// CHANNEL 3
#BIT PULSE4=PORTB.0/// CHANNEL 4
#BIT PULSE5=PORTC.0/// CHANNEL 5

#BIT KEY1=PORTB.1
#BIT KEY2=PORTB.2
#BIT KEY3=PORTB.3
#BIT KEY4=PORTB.4

#BIT PULL_UP=0X81.7

#DEFINE ZER0 2
#DEFINE HALF 7
#DEFINE FULL 9
#DEFINE ON 1
#DEFINE OFF 0

INT I=0;
INT1 K1=0,K2=0,K3=0,K4=0;
INT PERIOD=0,DUTY=0;
STRUCT
{
   INT P1,P2,P3,P4,P5;
   INT S1,S2,S3,S4,S5;
}PWM_DUTY;


#INT_TIMER2
TIMER0_ISR()
{
   PERIOD++;DUTY++;
   IF(PERIOD==10)
   {
      PERIOD=0;DUTY=0;PULSE1=PWM_DUTY.S1;PULSE2=PWM_DUTY.S2;
      PULSE3=PWM_DUTY.S3;PULSE4=PWM_DUTY.S4;PULSE5=PWM_DUTY.S5;
   }
   IF(PWM_DUTY.P1==DUTY){PULSE1=0;}
   IF(PWM_DUTY.P2==DUTY){PULSE2=0;}
   IF(PWM_DUTY.P3==DUTY){PULSE3=0;}
   IF(PWM_DUTY.P4==DUTY){PULSE4=0;}
   IF(PWM_DUTY.P5==DUTY){PULSE5=0;}
   
}

VOID PWM(INT CHANNEL,INT ANGLE,INT COND)
{
 
   IF(CHANNEL==1){PWM_DUTY.S1=COND;PWM_DUTY.P1=ANGLE;}
   IF(CHANNEL==2){PWM_DUTY.S2=COND;PWM_DUTY.P2=ANGLE;}
   IF(CHANNEL==3){PWM_DUTY.S3=COND;PWM_DUTY.P3=ANGLE;}
   IF(CHANNEL==4){PWM_DUTY.S4=COND;PWM_DUTY.P4=ANGLE;}
   IF(CHANNEL==5){PWM_DUTY.S5=COND;PWM_DUTY.P5=ANGLE;}

}

VOID MAIN()
{
   TRISB=0X1E;
   PORTB=0X00;
   TRISD=0X00;
   PORTB=0X00;
   PORTE=0X00;
   TRISE=0X00;
   TRISC=0X00;
   PORTC=0X00;

   PULL_UP=0;
   
   ENABLE_INTERRUPTS(GLOBAL);
   ENABLE_INTERRUPTS(INT_TIMER2);
   setup_timer_2 ( T2_DIV_BY_4, 138, 1);

 
   lcd_int();
   DELAY_MS(10);
   COMMAND(0X80);
   DATA("SERVO MOTOR");
   COMMAND(0XC0);
   DATA("****TEST*******");
   
   /*
   PWM(1,ZER0,ON);///(CHANNEL TO OPERATE, ANGLE , ON/OFF CONDITION)
   PWM(2,HALF,ON);
   PWM(3,FULL,ON);
   PWM(4,ZER0,ON);
   PWM(5,HALF,ON);
*/

   WHILE(1)

   {

IF(KEY1==0)
{
DELAY_MS(300);
K1=1;K2=0;K3=0;K4=0;
}
IF(KEY2==0)
{
DELAY_MS(300);
K1=0;K2=1;K3=0;K4=0;
}
IF(KEY3==0)
{
DELAY_MS(300);
K1=0;K2=0;K3=1;K4=0;
}
IF(KEY4==0)
{
DELAY_MS(300);
K1=0;K2=0;K3=0;K4=1;
}

IF(K1==1){ PWM(1,FULL,ON);}


   }
}
