#include<16f877a.h>
#use delay(clock=11059200)
#use rs232(baud=9600, xmit=PIN_c6,rcv=PIN_c7)

#byte trisc=0x87
#byte portc=0x07

#byte portd=0x08
#byte trisd=0x88

#byte porte=0x09
#byte trise=0x89

#bit reg=0x09.0
#bit rw=0x09.1
#bit en=0x09.2

#byte tmr0=0x01
#byte intcon=0x0b
#byte option_reg=0x81
#byte rcreg=0x1a

struct bit
{
unsigned char : 1 ;
unsigned int : 1;
}s1;

unsigned char a,b[5],arr_data[5],arr_add[5][5],var=0;
int i=0,j=0,k=0;
int1 flag=0,glag=0;
void command(unsigned char com);
void data(unsigned char da);

const unsigned char TEXT[51][5] ={0x00, 0x00, 0x00, 0x00, 0x00, // SPACE
                         0x00, 0x00, 0x5F, 0x00, 0x00, // !
                         0x00, 0x03, 0x00, 0x03, 0x00, // "
                         0x14, 0x3E, 0x14, 0x3E, 0x14, // #
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                         0x7F, 0x09, 0x09, 0x09, 0x76};// R

const unsigned char TEXT2[44][5]={0x26, 0x49, 0x49, 0x49, 0x32, // S
                         0x01, 0x01, 0x7F, 0x01, 0x01, // T
                         0x3F, 0x40, 0x40, 0x40, 0x3F, // U
                         0x1F, 0x20, 0x40, 0x20, 0x1F, // V
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                         0x02, 0x01, 0x02, 0x04, 0x02};// ~

#int_timer0
tmr0_isr(){
   porte = b;
   portd = array[b];
   b++;
   if(b == 8)b= 0;
}

#int_rda
rda_isr()
{
   var = fgetc();
   if(var < 'S')
      arr_data[k]=var-0x20;
   else
      arr_data[k]=var-'S';
   for(i=0;i<5;i++)
   {
      if(var < 'S')
         array[j]=TEXT[arr_data][i];
      else
         array[j]=TEXT2[arr_data][i];
   }
}

void command(unsigned int com)
{
portd=com;
reg=0;
rw=0;
en=1;
delay_ms(10);
en=0;
}

void data(unsigned int da)
{
portd=da;
reg=1;
rw=0;
en=1;
delay_ms(10);
en=0;
}
void main()
{
 portd=0x00;porte=0x00;portc=0x00;
 trisd=0x00;trise=0x00;trisc=0x80;

 tmr0=0x00;
 command(0x38);
 command(0x06);
 command(0x0c);
 command(0x01);

 enable_interrupts(global);
 enable_interrupts(int_rda);

 delay_ms(300);
 command(0x80);
 data("GRT EMBEDDED");
 command(0xc0);
 data("SOLUTIONS");
 delay_ms(1500);
 command(0x01);

 while(1)
 {

}
}
